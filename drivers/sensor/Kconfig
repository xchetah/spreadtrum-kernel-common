## drivers/sensor/Kconfig
```kconfig
menu "Sensor support"

config SENSORS
	bool "Support for sensors"
	help
	  Say Y here to add support for accelerometer sensors

if SENSORS

config SENSORS_GP2A
        tristate "Sharp GP2AP002A00F I2C Proximity/Opto sensor driver"
        depends on I2C
        help
	  Say Y here if you have a Sharp GP2AP002A00F proximity/als combo-chip
	  hooked to an I2C bus.
	  To compile this driver as a module, choose M here: the
	  module will be called gp2ap002a00f.
 
config SENSORS_BMA2X2
	tristate "BMA255/BMA250E/BMA222E/BMA280 acceleration sensor support"
	depends on I2C
	help
	  If you say yes here you get support for Bosch Sensortec's
	  acceleration sensors BMA255/BMA250E/BMA222E/BMA280.


config SENSORS_BMM050
	tristate "BMM050 Magnetic Sensor Driver"
	depends on I2C
	help
	 BMM050 Magnetic Sensor Driver implemented by Bosch-Sensortec.

config SENSORS_K2HH
	tristate "k2hh accelerometer sensor driver"
	depends on I2C
	help
	 k2hh accelerometer sensor driver.

endif
endmenu
```
